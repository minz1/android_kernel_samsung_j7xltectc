## drivers/motor/Kconfig
```kconfig
#
# Immersion TouchSense Player driver configuration
#
config MOTOR_DRV_MAX77843
        tristate "Maxim MAX77843 motor"
        default n
	depends on MFD_MAX77843

config MSM_VIBRATOR
	tristate "MSM_VIBRATOR"
	default n
	help
	  Say Y to enable MSM_VIBRATOR support

config SS_VIBRATOR
	tristate "SS_VIBRATOR"
	default n
	help
	  Say Y to enable SAMSUNG VIBRATOR support
```
