/* Copyright (c) 2012, Samsung Electronics Corporation. All rights reserved.
 *
 * This program is free software; you can redistribute it and/or modify
 * it under the terms of the GNU General Public License version 2 and
 * only version 2 as published by the Free Software Foundation.
 *
 * This program is distributed in the hope that it will be useful,
 * but WITHOUT ANY WARRANTY; without even the implied warranty of
 * MERCHANTABILITY or FITNESS FOR A PARTICULAR PURPOSE.  See the
 * GNU General Public License for more details.
 */

&mdss_mdp {
	ss_dsi_panel_ANA38401_AMS968HH01_QXGA: ss_dsi_panel_ANA38401_AMS968HH01_QXGA {
		qcom,mdss-dsi-panel-name = "ss_dsi_panel_ANA38401_AMS968HH01_QXGA";
		label = "ss_dsi_panel_ANA38401_AMS968HH01_QXGA";
		qcom,mdss-dsi-panel-width = <1024>;
		qcom,mdss-dsi-panel-height = <1536>;
		qcom,mdss-dsi-bpp = <24>;
		qcom,mdss-dsi-panel-timings = [FB 3C 2A 00 70 74 2E 40 33 03 04 00];

		qcom,mdss-dsi-on-command= [
			05 01 00 00 0A 00 01 11		/* Sleep out, wait 10ms */

			15 01 00 00 05 00 02 B0 7F		/* Global Para 127th */
			39 01 00 00 00 00 02 B2 15			/* TSP_HTE TSP_VTE Setting */
			39 01 00 00 00 00 03 44 05 F6		/* Set Tear Scanline 1526  */

			39 01 00 00 00 00 22				/* Brightness condition set */
				83
				80 80 80
				80 80 80
				80 00 80
				80 00 80
				80 80 80
				80 80 80
				00 80 80
				00 80 80
				80 80 80
				80 80 00
				80 80 00

			39 01 00 00 00 00 04 90 00 00 0E		/* AID 360 nit */
			15 01 00 00 00 00 02 B0 67		/* Global Para 103rd */
			39 01 00 00 00 00 02 B2 0F		/* 360 nit ELVSS */
			15 01 00 00 00 00 02 B0 4D		/* Global Para 77th */
			39 01 00 00 00 00 02 B2 04		/* 16 Frame Avg at ACL off */
			15 01 00 00 00 00 02 B0 36		/* Global Para 54th */
			39 01 00 00 00 00 02 B2 10		/* ACL off */
			15 01 00 00 00 00 02 B0 6D		/* Global Para 109th */
			39 01 00 00 00 00 02 B2 85		/* CAPS on */
			15 01 00 00 00 00 02 B0 35		/* Global Para 53rd */
			39 01 00 00 00 00 02 B2 01		/* Update key */
			15 01 00 00 00 00 02 B0 D0		/* Global Para 208th */
			39 01 00 00 00 00 02 B1 1D		/* UPLL_F = 35 */
		];

		qcom,mdss-dsi-off-command=[
			05 01 00 00 00 00 02 28 00
			05 01 00 00 78 00 02 10 00	/* wait 120ms(0x78) */
		];

/*		qcom,cont-splash-enabled;*/
		qcom,dcs-cmd-by-left;
		/*qcom,cmd-sync-wait-broadcast;*/
		/*qcom,cmd-sync-wait-trigger;*/
		/*qcom,mdss-dsi-fbc-enable=*/
		/*qcom,mdss-dsi-fbc-bpp=*/
		/*qcom,mdss-dsi-fbc-packing=*/
		/*qcom,mdss-dsi-fbc-quant-error=*/
		/*qcom,mdss-dsi-fbc-bias=*/
		/*qcom,mdss-dsi-fbc-pat-mode=*/
		/*qcom,mdss-dsi-fbc-vlc-mode=*/
		/*qcom,mdss-dsi-fbc-bflc-mode=*/
		/*qcom,mdss-dsi-fbc-h-line-budget=*/
		/*qcom,mdss-dsi-fbc-budget-ctrl=*/
		/*qcom,mdss-dsi-fbc-block-budget=*/
		/*qcom,mdss-dsi-fbc-lossless-threshold=*/
		/*qcom,mdss-dsi-fbc-lossy-threshold=*/
		/*qcom,mdss-dsi-fbc-rgb-threshold=*/
		/*qcom,mdss-dsi-fbc-lossy-mode-idx=*/

		qcom,mdss-dsi-h-back-porch = <108>;
		qcom,mdss-dsi-h-front-porch = <16>;
		qcom,mdss-dsi-h-pulse-width = <212>;
		qcom,mdss-dsi-h-sync-skew = <0>;
		qcom,mdss-dsi-v-back-porch = <6>;
		qcom,mdss-dsi-v-front-porch = <10>;
		qcom,mdss-dsi-v-pulse-width = <2>;

		qcom,mdss-dsi-h-left-border = <0>;
		qcom,mdss-dsi-h-right-border = <0>;
		qcom,mdss-dsi-v-top-border = <0>;
		qcom,mdss-dsi-v-bottom-border = <0>;

		qcom,mdss-dsi-underflow-color = <0xFF>;
		qcom,mdss-dsi-border-color = <0>;

		/*qcom,mdss-dsi-pan-enable-dynamic-fps=*/
		/*qcom,mdss-dsi-pan-fps-update=*/

		qcom,mdss-dsi-bl-pmic-control-type = "bl_ctrl_dcs";
		/*qcom,mdss-dsi-bl-pmic-bank-select=*/
		/*qcom,mdss-dsi-bl-pmic-pwm-frequency=*/
		/*qcom,mdss-dsi-pwm-gpio=*/

		qcom,mdss-dsi-bl-min-level = <1>;
		qcom,mdss-dsi-bl-max-level = <255>;
		qcom,mdss-brightness-max-level = <255>;
		qcom,mdss-dsi-interleave-mode = <0>;
		qcom,mdss-dsi-panel-type = "dsi_cmd_mode";

		/*qcom,mdss-dsi-te-check-enable; */
		qcom,mdss-dsi-te-using-te-pin;
		qcom,mdss-dsi-te-pin-select = <1>;

		qcom,mdss-dsi-te-dcs-command = <1>;
		qcom,mdss-dsi-wr-mem-start = <0x2C>;
		qcom,mdss-dsi-wr-mem-continue = <0x3C>;

		/* CMD mode panel doesn't need below stuff */
		/*qcom,mdss-dsi-h-sync-pulse=*/
		/*qcom,mdss-dsi-hfp-power-mode=*/
		/*qcom,mdss-dsi-hbp-power-mode=*/
		/*qcom,mdss-dsi-hsa-power-mode=*/
		/*qcom,mdss-dsi-last-line-interleave=*/
		/*qcom,mdss-dsi-bllp-eof-power-mode=*/
		/*qcom,mdss-dsi-bllp-power-mode=*/
		/*qcom,mdss-dsi-traffic-mode=*/

		qcom,mdss-dsi-pixel-packing = "loose";

		qcom,mdss-dsi-virtual-channel-id = <0>;
		qcom,mdss-dsi-color-order = "rgb_swap_rgb";
		qcom,mdss-dsi-lane-0-state;
		qcom,mdss-dsi-lane-1-state;
		qcom,mdss-dsi-lane-2-state;
		qcom,mdss-dsi-lane-3-state;
		qcom,mdss-dsi-lane-map = "lane_map_0123";

		qcom,mdss-dsi-t-clk-pre = <0x2E>;
		qcom,mdss-dsi-t-clk-post = <0x02>;

		qcom,mdss-dsi-stream = <0>;
		qcom,mdss-dsi-mdp-trigger = "none";
		qcom,mdss-dsi-dma-trigger = "trigger_sw";
		qcom,mdss-dsi-panel-framerate = <60>;
		/*qcom,mdss-dsi-panel-clockrate = <980500000>;*/
		qcom,mdss-dsi-on-command-state = "dsi_lp_mode";
		qcom,mdss-dsi-off-command-state = "dsi_hs_mode";

		qcom,mdss-pan-physical-width-dimension = <72>;
		qcom,mdss-pan-physical-height-dimension = <126>;

		qcom,mdss-dsi-panel-mode-gpio-state = "invalid";

		/*qcom,mdss-tear-check-disable*/
		qcom,mdss-tear-check-sync-cfg-height = <2576>;
		/*qcom,mdss-tear-check-sync-init-val=*/
		/*qcom,mdss-tear-check-sync-threshold-start=*/
		/*qcom,mdss-tear-check-sync-threshold-continue=*/
		/*qcom,mdss-tear-check-start-pos=*/
		/*qcom,mdss-tear-check-rd-ptr-trigger-intr=*/
		/*qcom,mdss-tear-check-frame-rate=*/

		qcom,mdss-dsi-reset-sequence = <1 5>, <0 5>, <1 5>;
/*		qcom,partial-update-enabled;*/
/*		qcom,partial-update-roi-merge;*/
/*		qcom,panel-roi-alignment=<8 8 1 1 1 2>;*/
		/*qcom,mdss-dsi-horizontal-line-idle*/

		qcom,mdss-dsi-lp11-init;
		qcom,mdss-dsi-init-delay-us = <1000>;

		qcom,mdss-dsi-rx-eot-ignore;
		qcom,mdss-dsi-tx-eot-append;

		qcom,ulps-enabled;
		/*qcom,suspend-ulps-enabled;*/
		/*qcom,esd-check-enabled*/
		/*qcom,mdss-dsi-panel-status-command=*/
		/*qcom,mdss-dsi-panel-status-command-mode="dsi_lp_mode";*/
		/*qcom,mdss-dsi-panel-status-check-mode="reg_read";*/
		/*qcom,mdss-dsi-panel-status-value=<1>;*/
		/*qcom,dynamic-mode-switch-enabled*/
		/*qcom,video-to-cmd-mode-switch-commands=*/
		/*qcom,cmd-to-video-mode-switch-commands=*/

/*
* ************************************************************************************************************************************
*
*
*			Below  parameters are samsung dependent thigs
*
*
* ************************************************************************************************************************************
*/
		samsung,support_panel_max = <1>;
		samsung,hw-config = "split_dsi";
		/*
		the last byte in read commands	represent READ LENGH,
		like below  READ LENGH = 0x21
		*/

		samsung,packet_size_tx_cmds_revA = [
			37 01 00 00 00 00 02 07 00
		];

		samsung,reg_read_pos_tx_cmds_revA = [
			15 01 00 00 00 00 02 B0 00
		];

		samsung,smart_dimming_mtp_rx_cmds_revA = [ 06 01 00 00 00 00 01 D8 21 5A];
		samsung,hbm_rx_cmds_revA = [ 06 01 00 00 00 00 01 D4 21 5B];	/* read D4 91~123rd , 91=0x5B*/
		samsung,hbm2_rx_cmds_revA = [ 06 01 00 00 00 00 01 D8 01 81];	/* read D8 129th , 129=0x81*/
		samsung,mdnie_read_rx_cmds_revA = [ 06 01 00 00 00 00 01 D8 04 7B];
		samsung,elvss_rx_cmds_revA = [ 06 01 00 00 00 00 01 D8 01 81];	/* read D8 129th , 129=0x81*/

		/* the last byte in all read commands will represent READ LENGH */
		samsung,manufacture_read_pre_tx_cmds_revA = [
			15 01 00 00 00 00 02 B0 75
			39 01 00 00 00 00 02 B2 28
		];

		samsung,manufacture_id0_rx_cmds_revA = [ 06 01 00 00 00 00 01 da 01 00];
		samsung,manufacture_id1_rx_cmds_revA = [ 06 01 00 00 00 00 01 db 01 00];
		samsung,manufacture_id2_rx_cmds_revA = [ 06 01 00 00 00 00 01 dc 01 00];

		samsung,manufacture_date_rx_cmds_revA = [ 06 01 00 00 00 00 01 D8 02 7F];	/* read D8 127~128th , 40=0x28*/

		samsung,ddi_id_rx_cmds_revA = [ 06 01 00 00 00 00 01 d6 05 00]; /* read D6 1~5th */


		samsung,display_on_tx_cmds_revA = [05 01 00 00 32 00 02 29 00];
		samsung,display_off_tx_cmds_revA = [05 01 00 00 32 00 02 28 00];

		samsung,elvss_lowtemp_tx_cmds_revA = [
			15 01 00 00 00 00 02 B0 67
			39 01 00 00 00 00 02 B2 00
		];	/* Low Temperature Command */

		samsung,elvss_lowtemp2_tx_cmds_revA = [
			15 01 00 00 00 00 02 B0 67
			39 01 00 00 00 00 02 B2 00

		];	/* Low Temperature Command: default */

		samsung,gamma_tx_cmds_revA = [

			39 01 00 00 00 00 22				/* Brightness condition set */
			83 80 80 80 80 80 80
			80 00 80 80 00 80 80
			80 80 80 80 80 00 80
			80 00 80 80 80 80 80
			80 80 00 80 80 00

			15 01 00 00 00 00 02 B0 35		/* Global Para 53rd */
			39 01 00 00 00 00 02 B2 01		/* Update key */
		];

		samsung,hbm_gamma_tx_cmds_revA = [
			39 01 00 00 00 00 22				/* Brightness condition set */
			83 80 80 80 80 80 80
			80 00 80 80 00 80 80
			80 80 80 80 80 00 80
			80 00 80 80 80 80 80
			80 80 00 80 80 00
		];

		samsung,hbm_etc_tx_cmds_revA = [
			39 01 00 00 00 00 04 90 00 00 0E		/* AID 360 nit */
			15 01 00 00 00 00 02 B0 70		/* Global Para 112nd */
			39 01 00 00 00 00 02 B2 00		/* HBM ELVSS */
			15 01 00 00 00 00 02 B0 4D		/* Global Para 77th */
			39 01 00 00 00 00 02 B2 05		/* 32 Frame Avg at ACL on */
			15 01 00 00 00 00 02 B0 36		/* Global Para 54th */
			39 01 00 00 00 00 02 B2 12		/* ACL on */
			15 01 00 00 00 00 02 B0 6D		/* Global Para 109th */
			39 01 00 00 00 00 02 B2 85		/* CAPS on */
			15 01 00 00 00 00 02 B0 35		/* Global Para 53rd */
			39 01 00 00 00 00 02 B2 01		/* Update key */
		];

		samsung,panel-hbm-off-cmds_revA = [
			15 00 00 00 00 00 02 B0 70		/* Global Para 112nd */
			39 00 00 00 00 00 02 B2 00		/* HBM ELVSS */
		];

		/*
		* ************************************************************************************************************************
		* AID command list and mappings
		* ************************************************************************************************************************
		*/
		samsung,aid_tx_cmds_revA = [
			39 01 00 00 00 00 04 90 01 00 7F /* 98.71% 2CD 0 */
			39 01 00 00 00 00 04 90 01 00 7D  /* 98.20% 3CD 1 */
			39 01 00 00 00 00 04 90 01 00 7A  /* 97.42% 4CD 2 */
			39 01 00 00 00 00 04 90 01 00 78  /* 96.91% 5CD 3 */
			39 01 00 00 00 00 04 90 01 00 75  /* 96.13% 6CD 4 */
			39 01 00 00 00 00 04 90 01 00 72  /* 95.36% 7CD 5 */
			39 01 00 00 00 00 04 90 01 00 6F  /* 94.59% 8CD 6 */
			39 01 00 00 00 00 04 90 01 00 6C  /* 93.81% 9CD 7 */
			39 01 00 00 00 00 04 90 01 00 69  /* 93.04% 10CD 8 */
			39 01 00 00 00 00 04 90 01 00 67  /* 92.53% 11CD 9 */
			39 01 00 00 00 00 04 90 01 00 65  /* 91.75% 12CD 10 */
			39 01 00 00 00 00 04 90 01 00 61  /* 90.98% 13CD 11 */
			39 01 00 00 00 00 04 90 01 00 5E  /* 90.21% 14CD 12 */
			39 01 00 00 00 00 04 90 01 00 5A  /* 89.18% 15CD 13 */
			39 01 00 00 00 00 04 90 01 00 58  /* 88.66% 16CD 14 */
			39 01 00 00 00 00 04 90 01 00 56  /* 88.14% 17CD 15 */
			39 01 00 00 00 00 04 90 01 00 50  /* 86.60% 19CD 16 */
			39 01 00 00 00 00 04 90 01 00 4D  /* 85.82% 20CD 17 */
			39 01 00 00 00 00 04 90 01 00 48  /* 84.54% 21CD 18 */
			39 01 00 00 00 00 04 90 01 00 45  /* 83.76% 22CD 19 */
			39 01 00 00 00 00 04 90 01 00 3F  /* 82.22% 24CD 20 */
			39 01 00 00 00 00 04 90 01 00 3C  /* 81.44% 25CD 21 */
			39 01 00 00 00 00 04 90 01 00 36  /* 79.90% 27CD 22 */
			39 01 00 00 00 00 04 90 01 00 30  /* 78.35% 29CD 23 */
			39 01 00 00 00 00 04 90 01 00 2C  /* 77.32% 30CD 24 */
			39 01 00 00 00 00 04 90 01 00 26  /* 75.77% 32CD 25 */
			39 01 00 00 00 00 04 90 01 00 1F  /* 73.97% 34CD 26 */
			39 01 00 00 00 00 04 90 01 00 16  /* 71.65% 37CD 27 */
			39 01 00 00 00 00 04 90 01 00 0F  /* 69.85% 39CD 28 */
			39 01 00 00 00 00 04 90 01 00 09  /* 68.30% 41CD 29 */
			39 01 00 00 00 00 04 90 00 00 FF  /* 65.72% 44CD 30 */
			39 01 00 00 00 00 04 90 00 00 F5  /* 63.14% 47CD 31 */
			39 01 00 00 00 00 04 90 00 00 EB  /* 60.57% 50CD 32 */
			39 01 00 00 00 00 04 90 00 00 E1  /* 57.99% 53CD 33 */
			39 01 00 00 00 00 04 90 00 00 D7  /* 55.41% 56CD 34 */
			39 01 00 00 00 00 04 90 00 00 C9  /* 51.80% 60CD 35 */
			39 01 00 00 00 00 04 90 00 00 BB  /* 48.20% 64CD 36 */
			39 01 00 00 00 00 04 90 00 00 AD  /* 44.59% 68CD 37 */
			39 01 00 00 00 00 04 90 00 00 99  /* 39.43% 72CD 38 */
			39 01 00 00 00 00 04 90 00 00 99  /* 39.43% 77CD 39 */
			39 01 00 00 00 00 04 90 00 00 99  /* 39.43% 82CD 40 */
			39 01 00 00 00 00 04 90 00 00 99  /* 39.43% 87CD 41 */
			39 01 00 00 00 00 04 90 00 00 99 /* 39.43% 93CD 42 */
			39 01 00 00 00 00 04 90 00 00 99  /* 39.43% 98CD 43 */
			39 01 00 00 00 00 04 90 00 00 99  /* 39.43% 105CD 44 */
			39 01 00 00 00 00 04 90 00 00 99  /* 39.43% 111CD 45 */
			39 01 00 00 00 00 04 90 00 00 99  /* 39.43% 119CD 46 */
			39 01 00 00 00 00 04 90 00 00 99  /* 39.43% 126CD 47 */
			39 01 00 00 00 00 04 90 00 00 99  /* 39.43% 134CD 48 */
			39 01 00 00 00 00 04 90 00 00 99  /* 39.43% 143CD 49 */
			39 01 00 00 00 00 04 90 00 00 99  /* 39.43% 152CD 50 */
			39 01 00 00 00 00 04 90 00 00 99  /* 39.43% 162CD 51 */
			39 01 00 00 00 00 04 90 00 00 99  /* 39.43% 172CD 52 */
			39 01 00 00 00 00 04 90 00 00 86  /* 34.54% 183CD 53 */
			39 01 00 00 00 00 04 90 00 00 71  /* 29.12% 195CD 54 */
			39 01 00 00 00 00 04 90 00 00 5C  /* 23.71% 207CD 55 */
			39 01 00 00 00 00 04 90 00 00 45  /* 17.78% 220CD 56 */
			39 01 00 00 00 00 04 90 00 00 2B  /* 11.08% 234CD 57 */
			39 01 00 00 00 00 04 90 00 00 0E  /* 3.61% 249CD 58 */
			39 01 00 00 00 00 04 90 00 00 0E  /* 3.61% 265CD 59 */
			39 01 00 00 00 00 04 90 00 00 0E  /* 3.61% 282CD 60 */
			39 01 00 00 00 00 04 90 00 00 0E  /* 3.61% 300CD 61 */
			39 01 00 00 00 00 04 90 00 00 0E  /* 3.61% 316CD 62 */
			39 01 00 00 00 00 04 90 00 00 0E  /* 3.61% 333CD 63 */
			39 01 00 00 00 00 04 90 00 00 0E  /* 3.61% 360CD 64 */
		];

		/* bl_level, Index in acl command list */
		samsung,aid_map_table_revA = <
			2	0		3	1		4	2		5	3		6	4
			7	5		8	6		9	7		10	8		11	9
			12	10		13	11		14	12		15	13		16	14
			17	15		19	16		20	17		21	18		22	19
			24	20		25	21		27	22		29	23		30	24
			32	25		34	26		37	27		39	28		41	29
			44	30		47	31		50	32		53	33		56	34
			60	35		64	36		68	37		72	38		77	39
			82	40		87	41		93	42		98	43		105	44
			111	45		119	46		126	47		134	48		143	49
			152	50		162	51		172	52		183	53		195	54
			207	55		220	56		234	57		249	58		265	59
			282	60		300	61		316	62		333	63		360	64
		>;

		/*
		* ************************************************************************************************************************
		* ACL command list and mappings
		* ************************************************************************************************************************
		*/
		samsung,acl_on_tx_cmds_revA = [
			15 01 00 00 00 00 02 B0 4D		/* Global Para 77th */
			39 01 00 00 00 00 02 B2 05		/* 32 Frame Avg at ACL on */
			]; /* ACL on, B2 <- 0x05 */

		samsung,acl_percent_tx_cmds_revA = [
			39 01 00 00 00 00 02 B2 10
			39 01 00 00 00 00 02 B2 11
			39 01 00 00 00 00 02 B2 12	/* default ACL 15% */
			39 01 00 00 00 00 02 B2 13
		];	/* ACL 25% */

		samsung,acl_off_tx_cmds_revA = [
			15 01 00 00 00 00 02 B0 4D		/* Global Para 77th */
			39 01 00 00 00 00 02 B2 04		/* 16 Frame Avg at ACL off */
			15 01 00 00 00 00 02 B0 36		/* Global Para 54th */
			39 01 00 00 00 00 02 B2 10		/* ACL off */
		];/*off, b2<-0x04*/

		/* bl_level , Index in acl command list */
		samsung,acl_map_table_revA =  <
			2	2		3	2		4	2		5	2		6	2
			7	2		8	2		9	2		10	2		11	2
			12	2		13	2		14	2		15	2		16	2
			17	2		19	2		20	2		21	2		22	2
			24	2		25	2		27	2		29	2		30	2
			32	2		34	2		37	2		39	2		41	2
			44	2		47	2		50	2		53	2		56	2
			60	2		64	2		68	2		72	2		77	2
			82	2		87	2		93	2		98	2		105	2
			111	2		119	2		126	2		134	2		143	2
			152	2		162	2		172	2		183	2		195	2
			207	2		220	2		234	2		249	2		265	2
			282	2		300	2		316	2		333	2		360	2
		>;
		/*
		* ************************************************************************************************************************
		* ELVSS(ACL Off) command list and mappings
		* ************************************************************************************************************************
		*/
		samsung,elvss_tx_cmds_revA = [
			39 01 00 00 00 00 02 b2 1A /* 60~105CD 0 */
			39 01 00 00 00 00 02 b2 19 /* 56CD, 111~119CD 1 */
			39 01 00 00 00 00 02 b2 18 /* 50~53CD, 126~134CD 2 */
			39 01 00 00 00 00 02 b2 17 /* 44~47CD, 143CD 3 */
			39 01 00 00 00 00 02 b2 16 /* 37~41CD, 152~162CD 4 */
			39 01 00 00 00 00 02 b2 15 /* 32~34CD, 172~207CD 5 */
			39 01 00 00 00 00 02 b2 14 /* 27~30CD, 220~249CD 6 */
			39 01 00 00 00 00 02 b2 13 /* 21~25CD, 265~282CD 7 */
			39 01 00 00 00 00 02 b2 12 /* 16~20CD, 300CD 8 */
			39 01 00 00 00 00 02 b2 11 /* 11~15CD, 316CD 9 */
			39 01 00 00 00 00 02 b2 10 /* 5~10CD, 333CD 10 */
			39 01 00 00 00 00 02 b2 0F /* 2 ~ 4CD, 360CD 11 */

		];

		/*
		* ************************************************************************************************************************
		* SMART ACL(ACL On) ELVSS command list and mappings
		* ************************************************************************************************************************
		*/

		/* 0xB2 address 103rd parameter value*/
		samsung,smart_acl_elvss_tx_cmds_revA = [
			39 01 00 00 00 00 02 b2 1A /* 60~105CD 0 */
			39 01 00 00 00 00 02 b2 19 /* 56CD, 111~119CD 1 */
			39 01 00 00 00 00 02 b2 18 /* 50~53CD, 126~134CD 2 */
			39 01 00 00 00 00 02 b2 17 /* 44~47CD, 143CD 3 */
			39 01 00 00 00 00 02 b2 16 /* 37~41CD, 152~162CD 4 */
			39 01 00 00 00 00 02 b2 15 /* 32~34CD, 172~207CD 5 */
			39 01 00 00 00 00 02 b2 14 /* 27~30CD, 220~282CD 6 */
			39 01 00 00 00 00 02 b2 13 /* 21~25CD, 300CD 7 */
			39 01 00 00 00 00 02 b2 12 /* 16~20CD, 316~333CD 8 */
			39 01 00 00 00 00 02 b2 11 /* 11~15CD, 360CD 9 */
			39 01 00 00 00 00 02 b2 10 /* 5~10CD, 10 */
			39 01 00 00 00 00 02 b2 0F /* 2 ~ 4CD, 11 */
		];

		/* bl_level, Index in elvss command list */
		samsung,smart_acl_elvss_map_table_revA = <
			2	11		3	11		4	11		5	10		6	10
			7	10		8	10		9	10		10	10		11	9
			12	9		13	9		14	9		15	9		16	8
			17	8		19	8		20	8		21	7		22	7
			24	7		25	7		27	6		29	6		30	6
			32	5		34	5		37	4		39	4		41	4
			44	3		47	3		50	2		53	2		56	1
			60	0		64	0		68	0		72	0		77	0
			82	0		87	0		93	0		98	0		105	0
			111	1		119	1		126	2		134	2		143	3
			152	4		162	4		172	5		183	5		195	5
			207	5		220	6		234	6		249	6		265	6
			282	6		300	7		316	8		333	8		360	9
		>;
		/*
		* ************************************************************************************************************************
		* candela to index mappings
		* ************************************************************************************************************************
		*/
		samsung,candela_map_table_revA = <
		/*<idx>   <from>  <till> <candella> */
			0	2	2	2
			1	3	6	3
			2	7	10	4
			3	11	14	5
			4	15	18	6
			5	19	22	7
			6	23	26	8
			7	27	30	9
			8	31	34	10
			9	35	38	11
			10	39	42	12
			11	43	46	13
			12	47	50	14
			13	51	54	15
			14	55	58	16
			15	59	62	17
			16	63	66	19
			17	67	70	20
			18	71	74	21
			19	75	78	22
			20	79	82	24
			21	83	86	25
			22	87	90	27
			23	91	94	29
			24	95	98	30
			25	99	102	32
			26	103	106	34
			27	107	110	37
			28	111	114	39
			29	115	118	41
			30	119	122	44
			31	123	126	47
			32	127	130	50
			33	131	133	53
			34	134	137	56
			35	138	141	60
			36	142	145	64
			37	146	149	68
			38	150	153	72
			39	154	157	77
			40	158	161	82
			41	162	165	87
			42	166	169	93
			43	170	173	98
			44	174	177	105
			45	178	181	111
			46	182	185	119
			47	186	189	126
			48	190	193	134
			49	194	197	143
			50	198	201	152
			51	202	205	162
			52	206	209	172
			53	210	213	183
			54	214	217	195
			55	218	221	207
			56	222	225	220
			57	226	229	234
			58	230	233	249
			59	234	237	265
			60	238	241	282
			61	242	245	300
			62	246	249	316
			63	250	254	333
			64	255	255	360
		>;
	};
};
